## fpga/mqnic/ZCU106/fpga_zynqmp/ps/petalinux/project-spec/meta-user/conf/layer.conf
```bitbake
# We have a conf and classes directory, add to BBPATH
BBPATH .= ":${LAYERDIR}"

# We have recipes-* directories, add to BBFILES
BBFILES += "${LAYERDIR}/recipes-*/*/*.bb \
	${LAYERDIR}/recipes-*/*/*.bbappend"

BBFILE_COLLECTIONS += "meta-user"
BBFILE_PATTERN_meta-user = "^${LAYERDIR}/"
BBFILE_PRIORITY_meta-user = "7"
LAYERSERIES_COMPAT_meta-user = "gatesgarth"
```

## meta-corundum/conf/layer.conf
```bitbake
BBPATH .= ":${LAYERDIR}"
BBFILES += "${LAYERDIR}/recipes-*/*/*.bb ${LAYERDIR}/recipes-*/*/*.bbappend"
BBFILE_COLLECTIONS += "meta-corundum"
BBFILE_PATTERN_meta-corundum = "^${LAYERDIR}/"
BBFILE_PRIORITY_meta-corundum = "5"
LAYERSERIES_COMPAT_meta-corundum = "gatesgarth"
```
